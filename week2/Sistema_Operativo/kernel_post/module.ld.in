OUTPUT_FORMAT(elf32-i386)
ENTRY(module_entry)

SECTIONS {
  /* El módulo se vincula para ejecutarse en __MODULE_LOAD_ADDRESS__ (sustituido por Makefile) */
  . = __MODULE_LOAD_ADDRESS__;

  .text : { *(.text*) }
  .rodata : { *(.rodata*) }
  .data : { *(.data*) }
  .bss : { *(.bss*) *(COMMON) }
  /DISCARD/ : { *(.eh_frame) *(.comment) }

  __module_end = .;
  __module_size = __module_end - __MODULE_LOAD_ADDRESS__;
}
